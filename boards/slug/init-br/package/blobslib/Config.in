## boards/slug/init-br/package/blobslib/Config.in
```kconfig
config BR2_PACKAGE_BLOBSLIB
       bool "blobslib"
       default n
       select BR2_PACKAGE_OPENCV
       help
	Builds blobslib, a library for finding blobs, using opencv.
```

## boards/slug/init-br/package/flashb/Config.in
```kconfig
config BR2_PACKAGE_FLASHB
	bool "flashb"
	default n
	select BR2_PACKAGE_GLIB
	select BR2_PACKAGE_LIBELF
	help
	  Utility for flashing Student Robotics over I2C.

config BR2_PACKAGE_FLASHB_IS_DEV
        bool "Build flashb from development tree"
	default n
	depends BR2_PACKAGE_FLASHB
	help
	  You might like to build flashb from a local development
	  tree.

config BR2_PACKAGE_FLASHB_DEV_PATH
        string "Path of flashb development tree"
	default ""
	depends BR2_PACKAGE_FLASHB_IS_DEV
	help
	  Full path of the flashb development tree that you'd like 
	  to build from.
	  The build will be done *within* the path you specify.
```

## boards/slug/init-br/package/glib/Config.in
```kconfig
config BR2_PACKAGE_GLIB
       bool "glib"
       default n
       select BR2_PACKAGE_PKGCONFIG
       select BR2_PACKAGE_LIBICONV
       select BR2_PACKAGE_LIBINTL
       help
		Build glib
```

## boards/slug/init-br/package/opencv/Config.in
```kconfig
config BR2_PACKAGE_OPENCV
       bool "opencv"
       default n
       select BR2_PACKAGE_LIBPNG
       help
	Build opencv.
		http://opencvlibrary.sourceforge.net/
```

## boards/slug/init-br/package/python/Config.in
```kconfig
config BR2_PACKAGE_PYTHON
	bool "python"
	default n
	help
	  The python language interpreter.

	  http://www.python.org/

config BR2_PACKAGE_PYTHON_SHARED_LIB
	bool "include shared library"
	default n
	depends on BR2_PACKAGE_PYTHON
	help
	  Build and install the python shared library.
 
```

## boards/slug/init-br/package/spcaview/Config.in
```kconfig
config BR2_PACKAGE_SPCAVIEW
	bool "spcatools"
	default n
	help
		Build the spca tools
```

## boards/slug/init-br/target/device/arm/Config.in
```kconfig
config BR2_TARGET_ARM_NSLU2
	bool "NSLU2"
	depends on BR2_armeb
	default n
	select BR2_PACKAGE_LINUX
	help
	  The Linksys NSLU2

config BR2_PACKAGE_LINUX
	bool "linux"
	default n
	depends on BR2_TARGET_ARM_NSLU2
	help
	    The Linux kernel.

	    http://www.kernel.org/

config BR2_PACKAGE_IXP425_OSAL
	bool "IXP425 Access Library"
	default n
	depends on BR2_TARGET_ARM_NSLU2
	depends on BR2_PACKAGE_LINUX
	help
		In order to build this you have to download some files 
		yourself.  See target/device/arm/ixp425-ethernet/README 
		for instructions.

config BR2_PACKAGE_IXP425_ETH
	bool "IXP425 Ethernet Driver"
	default n
	depends on BR2_PACKAGE_IXP425_OSAL
	help
		Build the IXP425 ethernet driver as a kernel module.
 
```

## buildroot/target/device/arm/Config.in
```kconfig
config BR2_TARGET_ARM_NSLU2
	bool "NSLU2"
	depends on BR2_armeb
	default n
	select BR2_PACKAGE_LINUX
	help
	  The Linksys NSLU2

config BR2_PACKAGE_LINUX
	bool "linux"
	default n
	depends on BR2_TARGET_ARM_NSLU2
	help
	    The Linux kernel.

	    http://www.kernel.org/
```

## slug/init-br/package/flashb/Config.in
```kconfig
config BR2_PACKAGE_FLASHB
	bool "flashb"
	default n
	select BR2_PACKAGE_GLIB
	select BR2_PACKAGE_LIBELF
	help
	  Utility for flashing Student Robotics over I2C.
```

## slug/init-br/package/ixp4xx-microcode/Config.in
```kconfig
config BR2_PACKAGE_IXP4XX_MICROCODE
       bool "ixp4xx-microcode"
       default n
       help
         Firmware for the IXP4XX network processing engine cores.
         Required on the NLSU2 if you want the network interface to
         work.
```

## slug/init-br/package/libiconv/Config.in
```kconfig
config BR2_PACKAGE_LIBICONV
       bool "libiconv"
       default n
       help
		Builds libiconv
```

## slug/init-br/package/libxb/Config.in
```kconfig
config BR2_PACKAGE_LIBXB
	bool "libxb"
	default n
	select BR2_PACKAGE_GLIB
	help
		Builds libxb, a library for interacting with Maxstream 
		XBee modules.
```

## slug/init-br/package/robovis/Config.in
```kconfig
config BR2_PACKAGE_ROBOVIS
       bool "robovis"
       default n
       select BR2_PACKAGE_BLOBSLIB
       help
	Build robovis.
	This is the Student Robotics python wrapper for blobslib.
  
```

## slug/init-br/package/spca5xx/Config.in
```kconfig
config BR2_PACKAGE_SPCA5XX
	bool "spca5xx"
	default n
	help
		Build the spca5xx webcam driver module.
```

## slug/init-br/package/spcaview/Config.in
```kconfig
config BR2_PACKAGE_SPCTOOLS
	bool "spcatools"
	default n
	help
		Build the spca tools
```

## slug/init-br/package/xbout/Config.in
```kconfig
config BR2_PACKAGE_XBOUT
	bool "xbout"
	default n
	select BR2_PACKAGE_LIBXB
	help
		Builds xbout.
```

## slug/init-br/target/initrd/Config.in
```kconfig
config BR2_TARGET_INITRD
       bool "Create an initrd"
       default n
       help
	Build an initrd.  Will be a cramfs.
```
